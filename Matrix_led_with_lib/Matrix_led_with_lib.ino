
#include <avr/pgmspace.h>
#include <LedControl.h>

const int numDevices = 4;
const long scrollDelay = 25;

unsigned long bufferLong [14] = {0}; 

LedControl lc = LedControl(22, 24, 23, 4);

typedef unsigned char prog_uchar;
const prog_uchar scrollText[] PROGMEM = {"  REMOTE LAB "};

void setup()
{
  for (int x=0; x < numDevices; x++)
  {
    lc.shutdown(x, false);
    lc.setIntensity(x, 0);
    lc.clearDisplay(x);
  }
  lc.setIntensity(2, 15);
  lc.setIntensity(1, 15);
}

void loop()
{ 
  scrollMessage(scrollText);
}

const prog_uchar font5x7 [] PROGMEM = 
{
    B00000000,  //Space (Char 0x20)
    B00000000,
    B00000000,
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    B00000000,
    5
};

void scrollFont() 
{
  for (int counter=0x20; counter<0x80; counter++)
  {
    loadBufferLong(counter);
    delay(500);
  }
}

void scrollMessage(prog_uchar * messageString)
{
  int counter = 0;
  int myChar=0;
  do 
  {
    myChar =  pgm_read_byte_near(messageString + counter); 
    if (myChar != 0)
    {
      loadBufferLong(myChar);
    }
    counter++;
  } 
  while (myChar != 0);
}

void loadBufferLong(int ascii)
{
  if (ascii >= 0x20 && ascii <=0x7f)
  {
    for (int a=0;a<7;a++)
    {
      unsigned long c = pgm_read_byte_near(font5x7 + ((ascii - 0x20) * 8) + a);
      unsigned long x = bufferLong [a*2];
      x = x | c;
      bufferLong [a*2] = x;
    }
    byte count = pgm_read_byte_near(font5x7 +((ascii - 0x20) * 8) + 7);
    for (byte x=0; x<count;x++)
    {
      rotateBufferLong();
      printBufferLong();
      delay(scrollDelay);
    }
  }
}

void rotateBufferLong()
{
  for (int a=0;a<7;a++)
  {
    unsigned long x = bufferLong [a*2];
    byte b = bitRead(x,31);
    x = x<<1;
    bufferLong [a*2] = x;
    x = bufferLong [a*2+1];
    x = x<<1;
    bitWrite(x,0,b);
    bufferLong [a*2+1] = x;
  }
}  

void printBufferLong()
{
  for (int a=0;a<7;a++)
  {
    unsigned long x = bufferLong [a*2+1];
    byte y = x;
    lc.setRow(3,a,y);
    x = bufferLong [a*2];
    y = (x>>24);
    lc.setRow(2,a,y);
    y = (x>>16);
    lc.setRow(1,a,y);
    y = (x>>8);
    lc.setRow(0,a,y);
  }
}
